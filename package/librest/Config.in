## package/librest/Config.in
```kconfig
config BR2_PACKAGE_LIBREST
	bool "librest"
	select BR2_PACKAGE_JSON_GLIB
	select BR2_PACKAGE_LIBGLIB2
	select BR2_PACKAGE_LIBSOUP3
	select BR2_PACKAGE_LIBXML2
	help
	  GLib-based library for accessing RESTful web services,
	  providing the rest-1.0 API consumed by the goa-backend
	  helpers in gnome-online-accounts.

	  https://gitlab.gnome.org/GNOME/librest
```

## package/mozjs140/Config.in
```kconfig
config BR2_PACKAGE_MOZJS140
	bool "mozjs140"
	depends on BR2_INSTALL_LIBSTDCPP
	depends on BR2_PACKAGE_PYTHON3
	depends on BR2_PACKAGE_HOST_RUSTC_TARGET_ARCH_SUPPORTS
	depends on BR2_PACKAGE_LLVM_ARCH_SUPPORTS # host-llvm
	depends on BR2_HOST_GCC_AT_LEAST_7 # host-llvm
	select BR2_PACKAGE_HOST_RUSTC
	select BR2_HOST_CMAKE_AT_LEAST_3_20 # host-llvm
	select BR2_PACKAGE_ICU
	select BR2_PACKAGE_ZLIB
	help
	  SpiderMonkey 140 is Mozilla's JavaScript engine, used by
	  GJS to provide the GNOME Shell's JavaScript runtime.

	  https://spidermonkey.dev/

comment "mozjs140 needs a toolchain w/ C++, python3, host gcc >= 7"
	depends on BR2_PACKAGE_HOST_RUSTC_TARGET_ARCH_SUPPORTS
	depends on BR2_PACKAGE_LLVM_ARCH_SUPPORTS
	depends on !BR2_INSTALL_LIBSTDCPP || \
		!BR2_PACKAGE_PYTHON3 || \
		!BR2_HOST_GCC_AT_LEAST_7
```

## package/mutter/Config.in
```kconfig
config BR2_PACKAGE_MUTTER
	bool "mutter"
	depends on BR2_PACKAGE_MESA3D
	depends on BR2_PACKAGE_GLYCIN
	depends on BR2_PACKAGE_LIBGTK4
	depends on BR2_PACKAGE_PIPEWIRE
	depends on BR2_PACKAGE_WAYLAND
	depends on BR2_PACKAGE_XWAYLAND
	depends on BR2_INIT_SYSTEMD
	depends on BR2_PACKAGE_GOBJECT_INTROSPECTION_ARCH_SUPPORTS
	depends on BR2_PACKAGE_PYTHON3 # gobject-introspection
	select BR2_PACKAGE_CAIRO
	select BR2_PACKAGE_COLORD
	select BR2_PACKAGE_LIBDISPLAY_INFO
	select BR2_PACKAGE_LIBDRM
	select BR2_PACKAGE_LIBEI
	select BR2_PACKAGE_LIBGRAPHEME
	select BR2_PACKAGE_HARFBUZZ
	select BR2_PACKAGE_LIBGLIB2
	select BR2_PACKAGE_GRAPHENE
	select BR2_PACKAGE_LIBINPUT
	select BR2_PACKAGE_PIXMAN
	select BR2_PACKAGE_LIBGUDEV
	select BR2_PACKAGE_GDK_PIXBUF
	select BR2_PACKAGE_GOBJECT_INTROSPECTION
	select BR2_PACKAGE_GNOME_DESKTOP
	select BR2_PACKAGE_GSETTINGS_DESKTOP_SCHEMAS
	select BR2_PACKAGE_WAYLAND_PROTOCOLS
	select BR2_PACKAGE_XKEYBOARD_CONFIG
	select BR2_PACKAGE_XLIB_LIBX11
	select BR2_PACKAGE_XLIB_LIBXAU
	select BR2_PACKAGE_XLIB_LIBXCOMPOSITE
	select BR2_PACKAGE_XLIB_LIBXCURSOR
	select BR2_PACKAGE_XLIB_LIBXDAMAGE
	select BR2_PACKAGE_XLIB_LIBXEXT
	select BR2_PACKAGE_XLIB_LIBXFIXES
	select BR2_PACKAGE_XLIB_LIBXI
	select BR2_PACKAGE_XLIB_LIBXINERAMA
	select BR2_PACKAGE_XLIB_LIBXRANDR
	select BR2_PACKAGE_LIBXCB
	select BR2_PACKAGE_STARTUP_NOTIFICATION
	help
	  Mutter is the Wayland compositor and window manager used
	  by GNOME Shell.

	  https://gitlab.gnome.org/GNOME/mutter

comment "mutter needs GTK4, Xwayland and python3"
	depends on BR2_PACKAGE_GOBJECT_INTROSPECTION_ARCH_SUPPORTS
	depends on BR2_PACKAGE_MESA3D
	depends on BR2_PACKAGE_GLYCIN
	depends on BR2_PACKAGE_PIPEWIRE
	depends on BR2_PACKAGE_WAYLAND
	depends on BR2_INIT_SYSTEMD
	depends on !BR2_PACKAGE_LIBGTK4 || \
		!BR2_PACKAGE_XWAYLAND || \
		!BR2_PACKAGE_PYTHON3
```

## package/nvidia-container-toolkit/Config.in
```kconfig
config BR2_PACKAGE_NVIDIA_CONTAINER_TOOLKIT
	bool "nvidia-container-toolkit"
	depends on BR2_x86_64 || BR2_aarch64
	depends on BR2_PACKAGE_NVIDIA_DRIVER
	depends on BR2_INIT_SYSTEMD
	depends on BR2_PACKAGE_HOST_GO_TARGET_ARCH_SUPPORTS
	depends on BR2_PACKAGE_HOST_GO_TARGET_CGO_LINKING_SUPPORTS
	depends on BR2_TOOLCHAIN_HAS_THREADS
	depends on !BR2_TOOLCHAIN_USES_UCLIBC
	depends on BR2_USE_MMU
	select BR2_PACKAGE_HOST_GO
	help
	  NVIDIA Container Toolkit ships the OCI runtime wrapper
	  (nvidia-container-runtime), CDI lifecycle hook
	  (nvidia-cdi-hook) and CLI (nvidia-ctk) used by container
	  runtimes (containerd, cri-o, runc) to expose NVIDIA GPUs to
	  containers via the Container Device Interface.

	  Includes the nvidia-cdi-refresh.service and .path units that
	  regenerate /var/run/cdi/nvidia.yaml whenever the driver or
	  toolkit changes.

	  https://github.com/NVIDIA/nvidia-container-toolkit

comment "nvidia-container-toolkit needs systemd and a glibc toolchain w/ threads"
	depends on BR2_x86_64 || BR2_aarch64
	depends on BR2_PACKAGE_NVIDIA_DRIVER
	depends on BR2_PACKAGE_HOST_GO_TARGET_ARCH_SUPPORTS
	depends on BR2_PACKAGE_HOST_GO_TARGET_CGO_LINKING_SUPPORTS
	depends on BR2_USE_MMU
	depends on !BR2_INIT_SYSTEMD || \
		!BR2_TOOLCHAIN_HAS_THREADS || BR2_TOOLCHAIN_USES_UCLIBC
```

## package/oksa-crds/Config.in
```kconfig
config BR2_PACKAGE_OKSA_CRDS
	bool
	help
	  Kubernetes CRDs used by oksa services.
```

## package/oksa-services/Config.in
```kconfig
config BR2_PACKAGE_OKSA_SERVICES
	bool "oksa services"
	depends on BR2_INIT_SYSTEMD
	depends on BR2_PACKAGE_K3S
	select BR2_PACKAGE_AVAHI
	select BR2_PACKAGE_AVAHI_DAEMON
	select BR2_PACKAGE_DBUS # Avahi client library
	select BR2_PACKAGE_OKSA_CRDS
	select BR2_PACKAGE_UTIL_LINUX
	select BR2_PACKAGE_UTIL_LINUX_MOUNTPOINT
	help
	  Puu Kubernetes AI service bootstrap manifests for k3s and
	  mDNS publication of api.puu.local.

comment "oksa services needs systemd"
	depends on BR2_PACKAGE_K3S
	depends on !BR2_INIT_SYSTEMD
```

## package/oksa/Config.in
```kconfig
config BR2_PACKAGE_OKSA
	bool "oksa"
	depends on BR2_INIT_SYSTEMD
	depends on BR2_PACKAGE_K3S
	depends on BR2_PACKAGE_PYTHON3
	depends on BR2_PACKAGE_HOST_RUSTC_TARGET_ARCH_SUPPORTS
	depends on BR2_TOOLCHAIN_HAS_SYNC_4
	depends on BR2_USE_MMU
	depends on !BR2_STATIC_LIBS
	depends on BR2_TOOLCHAIN_HAS_THREADS_NPTL
	depends on BR2_TOOLCHAIN_GCC_AT_LEAST_4_9
	depends on BR2_PACKAGE_GOBJECT_INTROSPECTION_ARCH_SUPPORTS
	depends on BR2_HOST_GCC_AT_LEAST_8
	depends on BR2_TOOLCHAIN_USES_GLIBC || BR2_TOOLCHAIN_USES_MUSL
	select BR2_PACKAGE_DBUS
	select BR2_PACKAGE_PYTHON_GOBJECT
	select BR2_PACKAGE_PYTHON3_SSL
	select BR2_PACKAGE_PYTHON_NICEGUI
	select BR2_PACKAGE_UTIL_LINUX
	select BR2_PACKAGE_UTIL_LINUX_MOUNTPOINT
	select BR2_PACKAGE_XDG_DBUS_PROXY
	help
	  Puu D-Bus model-serving administration, a local dashboard, Kubernetes
	  resources and service bootstrap for k3s.

comment "oksa needs systemd"
	depends on BR2_PACKAGE_K3S
	depends on !BR2_INIT_SYSTEMD
```

## package/plymouth/Config.in
```kconfig
config BR2_PACKAGE_PLYMOUTH
	bool "plymouth"
	depends on BR2_INIT_SYSTEMD
	select BR2_PACKAGE_CAIRO
	select BR2_PACKAGE_FREETYPE
	select BR2_PACKAGE_LIBDRM
	select BR2_PACKAGE_LIBPNG
	select BR2_PACKAGE_PANGO
	help
	  Plymouth provides a graphical boot animation while
	  the boot process happens in the background.

	  https://gitlab.freedesktop.org/plymouth/plymouth
```

## package/puu-firstboot/Config.in
```kconfig
# SPDX-License-Identifier: GPL-2.0-or-later
# Copyright (C) Opinsys Oy 2026

config BR2_PACKAGE_PUU_FIRSTBOOT
	bool "puu-firstboot"
	depends on BR2_INIT_SYSTEMD
	depends on BR2_PACKAGE_GNOME_SHELL
	depends on BR2_PACKAGE_GDM
	depends on BR2_PACKAGE_GNOME_SESSION
	depends on BR2_PACKAGE_GNOME_CONTROL_CENTER
	depends on BR2_PACKAGE_LIBGTK4
	depends on BR2_PACKAGE_LIBADWAITA
	depends on BR2_PACKAGE_OKSA
	depends on BR2_PACKAGE_PYTHON3
	depends on BR2_USE_MMU
	depends on BR2_PACKAGE_GOBJECT_INTROSPECTION_ARCH_SUPPORTS
	depends on BR2_TOOLCHAIN_GCC_AT_LEAST_4_9
	depends on BR2_HOST_GCC_AT_LEAST_8
	depends on BR2_TOOLCHAIN_USES_GLIBC || BR2_TOOLCHAIN_USES_MUSL
	select BR2_PACKAGE_PYTHON_GOBJECT
	select BR2_PACKAGE_DCONF
	help
	  Restricted GNOME first-boot session and unprivileged Python wizard.
	  Normal graphical login requires trusted setup completion.
	  Live installer sessions retain their existing login behavior.
```

## package/puu-installer/Config.in
```kconfig
config BR2_PACKAGE_PUU_INSTALLER
	bool "puu-installer"
	depends on BR2_aarch64 || BR2_i386 || BR2_x86_64 # systemd-boot
	depends on BR2_INSTALL_LIBSTDCPP
	depends on BR2_TOOLCHAIN_HAS_THREADS
	depends on BR2_TOOLCHAIN_HEADERS_AT_LEAST_5_9 # xfsprogs
	depends on BR2_USE_MMU
	depends on BR2_USE_WCHAR
	depends on !BR2_STATIC_LIBS
	depends on BR2_TOOLCHAIN_GCC_AT_LEAST_10 # C++20
	depends on BR2_PACKAGE_BOOTC
	depends on BR2_PACKAGE_LIBABSEIL_CPP_ARCH_SUPPORTS
	depends on BR2_PACKAGE_LIBURCU_ARCH_SUPPORTS # xfsprogs
	depends on BR2_INIT_SYSTEMD
	select BR2_PACKAGE_DOSFSTOOLS
	select BR2_PACKAGE_DOSFSTOOLS_MKFS_FAT
	select BR2_PACKAGE_E2FSPROGS
	select BR2_PACKAGE_LIBABSEIL_CPP
	select BR2_PACKAGE_OPENSSL
	select BR2_PACKAGE_SYSTEMD_BOOT
	select BR2_PACKAGE_UTIL_LINUX
	select BR2_PACKAGE_UTIL_LINUX_LIBBLKID
	select BR2_PACKAGE_UTIL_LINUX_UNSHARE
	select BR2_PACKAGE_XFSPROGS
	help
	  Installer for Puu OS images.

	  https://gitlab.com/puu-os/installer
```

## package/python-httptools/Config.in
```kconfig
config BR2_PACKAGE_PYTHON_HTTPTOOLS
	bool "python-httptools"
	depends on BR2_PACKAGE_PYTHON3
	help
	  Framework-independent HTTP protocol parsers for Python.

	  https://github.com/MagicStack/httptools
```

## package/python-nicegui/Config.in
```kconfig
config BR2_PACKAGE_PYTHON_NICEGUI
	bool "python-nicegui"
	depends on BR2_PACKAGE_PYTHON3
	depends on BR2_PACKAGE_HOST_RUSTC_TARGET_ARCH_SUPPORTS
	depends on BR2_TOOLCHAIN_HAS_SYNC_4
	depends on BR2_USE_MMU
	depends on !BR2_STATIC_LIBS
	depends on BR2_TOOLCHAIN_HAS_THREADS_NPTL
	depends on BR2_TOOLCHAIN_GCC_AT_LEAST_4_9
	select BR2_PACKAGE_PYTHON3_SSL
	select BR2_PACKAGE_PYTHON_AIOFILES
	select BR2_PACKAGE_PYTHON_AIOHTTP
	select BR2_PACKAGE_PYTHON_ANYIO
	select BR2_PACKAGE_PYTHON_CERTIFI
	select BR2_PACKAGE_PYTHON_DOCUTILS
	select BR2_PACKAGE_PYTHON_DOTENV
	select BR2_PACKAGE_PYTHON_FASTAPI
	select BR2_PACKAGE_PYTHON_H11
	select BR2_PACKAGE_PYTHON_HTTPTOOLS
	select BR2_PACKAGE_PYTHON_HTTPX
	select BR2_PACKAGE_PYTHON_IDNA
	select BR2_PACKAGE_PYTHON_IFADDR
	select BR2_PACKAGE_PYTHON_ITSDANGEROUS
	select BR2_PACKAGE_PYTHON_JINJA2
	select BR2_PACKAGE_PYTHON_MARKDOWN2
	select BR2_PACKAGE_PYTHON_MULTIDICT
	select BR2_PACKAGE_PYTHON_MULTIPART
	select BR2_PACKAGE_PYTHON_ORJSON
	select BR2_PACKAGE_PYTHON_PYDANTIC_CORE
	select BR2_PACKAGE_PYTHON_PYGMENTS
	select BR2_PACKAGE_PYTHON_PYYAML
	select BR2_PACKAGE_PYTHON_SOCKETIO
	select BR2_PACKAGE_PYTHON_TINYCSS2
	select BR2_PACKAGE_PYTHON_TYPING_EXTENSIONS
	select BR2_PACKAGE_PYTHON_UVICORN
	select BR2_PACKAGE_PYTHON_UVLOOP
	select BR2_PACKAGE_PYTHON_WATCHFILES
	select BR2_PACKAGE_PYTHON_WEBSOCKETS
	help
	  Web-based user interfaces with bundled browser assets, including
	  Uvicorn's standard and Socket.IO's asyncio-client dependencies.

	  https://nicegui.io
```

## package/python-watchfiles/Config.in
```kconfig
config BR2_PACKAGE_PYTHON_WATCHFILES
	bool "python-watchfiles"
	depends on BR2_PACKAGE_PYTHON3
	depends on BR2_PACKAGE_HOST_RUSTC_TARGET_ARCH_SUPPORTS
	select BR2_PACKAGE_PYTHON_ANYIO
	help
	  File watching and code reload for Python.

	  https://github.com/samuelcolvin/watchfiles
```

## package/toolbx/Config.in
```kconfig
# SPDX-License-Identifier: GPL-2.0-or-later
# Copyright (C) Opinsys Oy 2026

config BR2_PACKAGE_TOOLBX
	bool "toolbx"
	depends on BR2_x86_64 || BR2_aarch64
	depends on BR2_INIT_SYSTEMD
	depends on BR2_PACKAGE_HOST_GO_TARGET_ARCH_SUPPORTS
	depends on BR2_PACKAGE_HOST_GO_TARGET_CGO_LINKING_SUPPORTS
	depends on BR2_PACKAGE_PODMAN
	depends on BR2_TOOLCHAIN_HAS_THREADS
	depends on !BR2_TOOLCHAIN_USES_UCLIBC
	depends on BR2_USE_MMU
	depends on !BR2_STATIC_LIBS
	select BR2_PACKAGE_HOST_GO
	select BR2_PACKAGE_SHADOW
	select BR2_PACKAGE_SHADOW_SUBORDINATE_IDS
	help
	  Toolbx is a tool for Linux, which allows the use of
	  interactive command line environments for software development
	  and troubleshooting the host operating system, without having
	  to install software on the host. It is built on top of Podman
	  and other standard container technologies from OCI.

	  https://containertoolbx.org/

comment "toolbx needs systemd and a glibc/musl toolchain w/ threads, dynamic library"
	depends on BR2_x86_64 || BR2_aarch64
	depends on BR2_PACKAGE_HOST_GO_TARGET_ARCH_SUPPORTS
	depends on BR2_PACKAGE_HOST_GO_TARGET_CGO_LINKING_SUPPORTS
	depends on BR2_PACKAGE_PODMAN
	depends on BR2_USE_MMU
	depends on !BR2_INIT_SYSTEMD || \
		!BR2_TOOLCHAIN_HAS_THREADS || BR2_TOOLCHAIN_USES_UCLIBC || \
		BR2_STATIC_LIBS
```

## package/xdg-desktop-portal-gtk/Config.in
```kconfig
config BR2_PACKAGE_XDG_DESKTOP_PORTAL_GTK
	bool "xdg-desktop-portal-gtk"
	depends on BR2_PACKAGE_XDG_DESKTOP_PORTAL
	depends on BR2_PACKAGE_LIBGTK3
	help
	  GTK back-end implementation for xdg-desktop-portal.

	  https://github.com/flatpak/xdg-desktop-portal-gtk
```

## package/xdg-desktop-portal/Config.in
```kconfig
config BR2_PACKAGE_XDG_DESKTOP_PORTAL
	bool "xdg-desktop-portal"
	depends on BR2_PACKAGE_FLATPAK
	depends on BR2_PACKAGE_PIPEWIRE
	depends on BR2_PACKAGE_GST1_PLUGINS_BASE
	depends on BR2_INIT_SYSTEMD
	select BR2_PACKAGE_GDK_PIXBUF
	select BR2_PACKAGE_LIBFUSE3
	select BR2_PACKAGE_LIBGLIB2
	select BR2_PACKAGE_LIBGUDEV
	select BR2_PACKAGE_JSON_GLIB
	help
	  A portal frontend service providing file chooser, screen
	  cast, remote desktop, and other desktop integration portals
	  for Flatpak and non-Flatpak applications.

	  https://github.com/flatpak/xdg-desktop-portal
```

## sdk/aarch64_defconfig
```kconfig
# SPDX-License-Identifier: GPL-2.0-or-later
# Copyright (C) Opinsys Oy 2026
# Toolchain SDK configuration for aarch64.

BR2_aarch64=y
BR2_TOOLCHAIN_BUILDROOT_VENDOR="puu"
BR2_KERNEL_HEADERS_7_1=y
BR2_BINUTILS_VERSION_2_46_X=y
BR2_GCC_VERSION_15_X=y
BR2_TOOLCHAIN_BUILDROOT_CXX=y
BR2_GCC_ENABLE_OPENMP=y
BR2_GCC_ENABLE_GRAPHITE=y
BR2_JLEVEL=8
BR2_CCACHE=y
BR2_CCACHE_INITIAL_SETUP="--max-size 20G"
BR2_OPTIMIZE_3=y
BR2_REPRODUCIBLE=y
BR2_INIT_NONE=y
BR2_SYSTEM_BIN_SH_NONE=y
# BR2_PACKAGE_BUSYBOX is not set
# BR2_TARGET_ROOTFS_TAR is not set
```
