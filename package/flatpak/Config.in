## package/libadwaita/Config.in
```kconfig
config BR2_PACKAGE_LIBADWAITA
	bool "libadwaita"
	depends on BR2_PACKAGE_LIBGTK4
	depends on BR2_PACKAGE_GOBJECT_INTROSPECTION_ARCH_SUPPORTS
	depends on BR2_PACKAGE_PYTHON3 # gobject-introspection
	select BR2_PACKAGE_APPSTREAM
	select BR2_PACKAGE_LIBFRIBIDI
	select BR2_PACKAGE_LIBGLIB2
	select BR2_PACKAGE_GOBJECT_INTROSPECTION
	help
	  Building blocks for modern GNOME applications following
	  the GNOME HIG.  Provides AdwApplication, responsive widgets,
	  and adaptive UI primitives.

	  https://gitlab.gnome.org/GNOME/libadwaita

comment "libadwaita needs python3"
	depends on BR2_PACKAGE_GOBJECT_INTROSPECTION_ARCH_SUPPORTS
	depends on BR2_PACKAGE_LIBGTK4
	depends on !BR2_PACKAGE_PYTHON3
```

## package/libei/Config.in
```kconfig
config BR2_PACKAGE_LIBEI
	bool "libei"
	depends on BR2_INIT_SYSTEMD
	select BR2_PACKAGE_LIBEVDEV
	select BR2_PACKAGE_LIBXKBCOMMON
	help
	  Library for emulated input. Provides libei (client) and
	  libeis (server) consumed by Wayland compositors such as
	  Mutter for synthetic input handling.

	  https://gitlab.freedesktop.org/libinput/libei
```

## package/libfyaml/Config.in
```kconfig
config BR2_PACKAGE_LIBFYAML
	bool "libfyaml"
	help
	  A fully YAML 1.1/1.2/1.3 conformant parser/emitter library.

	  Required by appstream >= 1.1.0 (replaces libyaml in that
	  branch).

	  https://github.com/pantoniou/libfyaml
```

## package/libgrapheme/Config.in
```kconfig
config BR2_PACKAGE_LIBGRAPHEME
	bool "libgrapheme"
	help
	  Free and open-source C99 library providing utilities for
	  Unicode (text segmentation, character properties, etc.).
	  Used by Mutter starting with the GNOME 47 release line.

	  https://libs.suckless.org/libgrapheme
```

## package/libgusb/Config.in
```kconfig
config BR2_PACKAGE_LIBGUSB
	bool "libgusb"
	select BR2_PACKAGE_JSON_GLIB
	select BR2_PACKAGE_LIBGLIB2
	select BR2_PACKAGE_LIBUSB
	help
	  GObject wrapper for libusb1 used by colord and other
	  hardware-management projects.

	  https://github.com/hughsie/libgusb
```

## package/libgweather/Config.in
```kconfig
config BR2_PACKAGE_LIBGWEATHER
	bool "libgweather"
	depends on BR2_PACKAGE_LIBSOUP3
	depends on BR2_PACKAGE_GOBJECT_INTROSPECTION_ARCH_SUPPORTS
	depends on BR2_PACKAGE_PYTHON3 # gobject-introspection
	select BR2_PACKAGE_GEOCODE_GLIB
	select BR2_PACKAGE_GWEATHER_LOCATIONS
	select BR2_PACKAGE_LIBGLIB2
	select BR2_PACKAGE_LIBXML2
	select BR2_PACKAGE_GOBJECT_INTROSPECTION
	select BR2_PACKAGE_JSON_GLIB
	help
	  Library used by GNOME applications to access weather data.
	  gnome-settings-daemon's night-light/location plugin and the
	  GNOME Weather application use this.

	  https://gitlab.gnome.org/GNOME/libgweather

comment "libgweather needs python3"
	depends on BR2_PACKAGE_LIBSOUP3
	depends on BR2_PACKAGE_GOBJECT_INTROSPECTION_ARCH_SUPPORTS
	depends on !BR2_PACKAGE_PYTHON3
```

## package/libnma/Config.in
```kconfig
config BR2_PACKAGE_LIBNMA
	bool "libnma"
	depends on BR2_PACKAGE_NETWORK_MANAGER
	depends on BR2_PACKAGE_LIBGTK3
	depends on BR2_PACKAGE_LIBGTK4
	help
	  NetworkManager GUI library providing GTK widgets for
	  connection editing and wireless security dialogs.

	  https://gitlab.gnome.org/GNOME/libnma
```

## package/libnotify/Config.in
```kconfig
config BR2_PACKAGE_LIBNOTIFY
	bool "libnotify"
	select BR2_PACKAGE_GDK_PIXBUF
	select BR2_PACKAGE_LIBGLIB2
	help
	  Library for sending desktop notifications to a notification
	  daemon, as defined by the freedesktop.org notification
	  specification. Used by GNOME components to surface user-facing
	  alerts.

	  https://gitlab.gnome.org/GNOME/libnotify
```
