## package/flatpak/Config.in
```kconfig
config BR2_PACKAGE_FLATPAK
	bool "flatpak"
	depends on BR2_PACKAGE_APPSTREAM
	depends on BR2_PACKAGE_BUBBLEWRAP
	depends on BR2_PACKAGE_FUSE_OVERLAYFS
	depends on BR2_PACKAGE_LIBOSTREE
	depends on BR2_PACKAGE_LIBXMLB
	depends on BR2_PACKAGE_XDG_DBUS_PROXY
	select BR2_PACKAGE_DCONF
	select BR2_PACKAGE_GDK_PIXBUF
	select BR2_PACKAGE_JSON_GLIB
	select BR2_PACKAGE_LIBARCHIVE
	select BR2_PACKAGE_LIBCAP
	select BR2_PACKAGE_LIBCURL
	select BR2_PACKAGE_LIBGLIB2
	select BR2_PACKAGE_LIBGPGME
	select BR2_PACKAGE_LIBSECCOMP
	select BR2_PACKAGE_LIBXML2
	select BR2_PACKAGE_POLKIT
	select BR2_PACKAGE_XLIB_LIBXAU
	select BR2_PACKAGE_ZSTD
	help
	  Flatpak is a system for building, distributing, and running
	  sandboxed desktop applications on Linux.

	  https://github.com/flatpak/flatpak
```

## package/gcr3/Config.in
```kconfig
config BR2_PACKAGE_GCR3
	bool "gcr3"
	depends on BR2_PACKAGE_LIBGPG_ERROR_ARCH_SUPPORTS # libgcrypt -> libgpg-error
	depends on BR2_USE_WCHAR # libglib2
	depends on BR2_TOOLCHAIN_HAS_THREADS # libglib2
	depends on BR2_USE_MMU # libglib2
	depends on !BR2_STATIC_LIBS # p11-kit
	select BR2_PACKAGE_LIBGCRYPT
	select BR2_PACKAGE_LIBGLIB2
	select BR2_PACKAGE_P11_KIT
	help
	  Legacy GNOME crypto library (gcr-3 / gck-1 ABI), built UI-less
	  to provide gcr-base-3 and gck-1 for gnome-keyring. Coexists
	  with the modern gcr (gcr-4) package.

	  https://gitlab.gnome.org/GNOME/gcr

comment "gcr3 needs a toolchain w/ wchar, threads, dynamic library"
	depends on BR2_PACKAGE_LIBGPG_ERROR_ARCH_SUPPORTS
	depends on BR2_USE_MMU
	depends on !BR2_USE_WCHAR || !BR2_TOOLCHAIN_HAS_THREADS || \
		BR2_STATIC_LIBS
```

## package/gdm/Config.in
```kconfig
config BR2_PACKAGE_GDM
	bool "gdm"
	depends on BR2_PACKAGE_ACCOUNTSSERVICE
	depends on BR2_PACKAGE_GNOME_SHELL
	depends on BR2_PACKAGE_GNOME_SESSION
	depends on BR2_PACKAGE_LINUX_PAM
	depends on BR2_INIT_SYSTEMD
	depends on BR2_TOOLCHAIN_HAS_SYNC_4 # xwayland
	select BR2_PACKAGE_DBUS
	select BR2_PACKAGE_DCONF
	select BR2_PACKAGE_LIBGLIB2
	select BR2_PACKAGE_SYSTEMD_LOGIND
	# gdm dynamically registers gdm-greeter via systemd-userdbd.
	select BR2_PACKAGE_SYSTEMD_USERDB
	help
	  GDM is the GNOME Display Manager.  It runs the graphical
	  login chain on Wayland or X11, hands off to gnome-session
	  on success, and drives the lock screen.

	  https://gitlab.gnome.org/GNOME/gdm

comment "gdm needs systemd and a toolchain w/ 4-byte atomics"
	depends on BR2_PACKAGE_ACCOUNTSSERVICE
	depends on BR2_PACKAGE_GNOME_SHELL
	depends on BR2_PACKAGE_GNOME_SESSION
	depends on BR2_PACKAGE_LINUX_PAM
	depends on !BR2_INIT_SYSTEMD || \
		!BR2_TOOLCHAIN_HAS_SYNC_4
```

## package/geoclue/Config.in
```kconfig
config BR2_PACKAGE_GEOCLUE
	bool "geoclue"
	depends on BR2_PACKAGE_LIBSOUP3
	select BR2_PACKAGE_AVAHI
	select BR2_PACKAGE_AVAHI_LIBAVAHI_CLIENT
	select BR2_PACKAGE_AVAHI_DAEMON
	select BR2_PACKAGE_DBUS
	select BR2_PACKAGE_JSON_GLIB
	select BR2_PACKAGE_LIBGLIB2
	select BR2_PACKAGE_MODEM_MANAGER
	help
	  Geoclue is a D-Bus geoinformation service. The goal of the
	  Geoclue project is to make creating location-aware
	  applications as simple as possible.

	  https://gitlab.freedesktop.org/geoclue/geoclue
```

## package/glycin/Config.in
```kconfig
config BR2_PACKAGE_GLYCIN
	bool "glycin"
	depends on BR2_USE_MMU # bubblewrap
	depends on BR2_INSTALL_LIBSTDCPP
	depends on BR2_PACKAGE_HOST_RUSTC_TARGET_ARCH_SUPPORTS
	depends on BR2_TOOLCHAIN_GCC_AT_LEAST_7 # libjxl
	depends on BR2_TOOLCHAIN_HAS_ATOMIC # libjxl
	depends on BR2_TOOLCHAIN_HAS_THREADS # libjxl
	depends on !BR2_STATIC_LIBS # libjxl
	depends on !BR2_TOOLCHAIN_HAS_GCC_BUG_81426 # libjxl
	select BR2_PACKAGE_BUBBLEWRAP # runtime
	select BR2_PACKAGE_FONTCONFIG
	select BR2_PACKAGE_HOST_RUSTC
	select BR2_PACKAGE_LCMS2
	select BR2_PACKAGE_LIBGLIB2
	select BR2_PACKAGE_LIBJXL
	select BR2_PACKAGE_LIBSECCOMP
	help
	  Glycin is a sandboxed and extendable image loading and
	  editing library, used by mutter to load wallpaper and
	  background images.  Includes the JPEG XL loader used
	  by GNOME 49 wallpapers.

	  https://gitlab.gnome.org/GNOME/glycin

comment "glycin needs a toolchain w/ C++, threads, gcc >= 7, dynamic library"
	depends on BR2_USE_MMU
	depends on BR2_PACKAGE_HOST_RUSTC_TARGET_ARCH_SUPPORTS
	depends on BR2_TOOLCHAIN_HAS_ATOMIC
	depends on !BR2_TOOLCHAIN_HAS_GCC_BUG_81426
	depends on !BR2_INSTALL_LIBSTDCPP || \
		!BR2_TOOLCHAIN_GCC_AT_LEAST_7 || \
		!BR2_TOOLCHAIN_HAS_THREADS || \
		BR2_STATIC_LIBS
```

## package/gnome-control-center/Config.in
```kconfig
config BR2_PACKAGE_GNOME_CONTROL_CENTER
	bool "gnome-control-center"
	depends on BR2_PACKAGE_ACCOUNTSSERVICE
	depends on BR2_PACKAGE_CUPS
	depends on BR2_PACKAGE_GNOME_BLUETOOTH
	depends on BR2_PACKAGE_GNOME_SETTINGS_DAEMON
	depends on BR2_PACKAGE_NETWORK_MANAGER
	depends on BR2_PACKAGE_PIPEWIRE
	depends on BR2_PACKAGE_UPOWER
	depends on BR2_INIT_SYSTEMD
	depends on BR2_PACKAGE_LIBADWAITA
	depends on BR2_PACKAGE_LIBGTK3
	depends on BR2_PACKAGE_LIBGTK4
	depends on BR2_PACKAGE_PYTHON3 # gobject-introspection
	select BR2_PACKAGE_DBUS
	select BR2_PACKAGE_COLORD
	select BR2_PACKAGE_COLORD_GTK
	select BR2_PACKAGE_GCR
	select BR2_PACKAGE_GDK_PIXBUF
	select BR2_PACKAGE_GNOME_DESKTOP
	select BR2_PACKAGE_GNOME_ONLINE_ACCOUNTS
	select BR2_PACKAGE_GSETTINGS_DESKTOP_SCHEMAS
	select BR2_PACKAGE_GSOUND
	select BR2_PACKAGE_IBUS
	select BR2_PACKAGE_JSON_GLIB
	select BR2_PACKAGE_LIBEPOXY
	select BR2_PACKAGE_LIBGUDEV
	select BR2_PACKAGE_LIBGTOP
	select BR2_PACKAGE_LIBGLIB2
	select BR2_PACKAGE_LIBNMA
	select BR2_PACKAGE_LIBPWQUALITY
	select BR2_PACKAGE_LIBWACOM
	select BR2_PACKAGE_LIBXML2
	select BR2_PACKAGE_MODEM_MANAGER
	select BR2_PACKAGE_PULSEAUDIO
	select BR2_PACKAGE_POLKIT
	select BR2_PACKAGE_UDISKS
	select BR2_PACKAGE_XLIB_LIBX11
	select BR2_PACKAGE_XLIB_LIBXI
	select BR2_PACKAGE_BOLT
	select BR2_PACKAGE_GNUTLS
	select BR2_PACKAGE_LIBKRB5
	select BR2_PACKAGE_ADWAITA_ICON_THEME
	select BR2_PACKAGE_ADWAITA_FONTS
	select BR2_PACKAGE_GNOME_BACKGROUNDS
	select BR2_PACKAGE_SHARED_MIME_INFO
	help
	  GNOME Settings is the unified configuration application for
	  the GNOME desktop.  It exposes panels for displays, sound,
	  power, networking, accounts, sharing, etc.

	  https://gitlab.gnome.org/GNOME/gnome-control-center
```

## package/gnome-desktop/Config.in
```kconfig
config BR2_PACKAGE_GNOME_DESKTOP
	bool "gnome-desktop"
	depends on BR2_PACKAGE_LIBGTK3
	depends on BR2_PACKAGE_LIBGTK4
	depends on BR2_PACKAGE_XKEYBOARD_CONFIG
	depends on BR2_PACKAGE_GOBJECT_INTROSPECTION_ARCH_SUPPORTS
	depends on BR2_PACKAGE_PYTHON3 # gobject-introspection
	select BR2_PACKAGE_FONTCONFIG
	select BR2_PACKAGE_GDK_PIXBUF
	select BR2_PACKAGE_GSETTINGS_DESKTOP_SCHEMAS
	select BR2_PACKAGE_ISO_CODES
	select BR2_PACKAGE_LIBGLIB2
	select BR2_PACKAGE_LIBSECCOMP
	select BR2_PACKAGE_LIBXKBCOMMON
	select BR2_PACKAGE_GOBJECT_INTROSPECTION
	help
	  Library used by GNOME applications for desktop-wide
	  integration: monitor configuration, idle detection,
	  thumbnailing, language utilities, and the GNOME
	  version metadata.  Provides libgnome-desktop-4 used
	  by xdg-desktop-portal-gnome.

	  https://gitlab.gnome.org/GNOME/gnome-desktop

comment "gnome-desktop needs python3"
	depends on BR2_PACKAGE_GOBJECT_INTROSPECTION_ARCH_SUPPORTS
	depends on BR2_PACKAGE_LIBGTK3
	depends on BR2_PACKAGE_LIBGTK4
	depends on BR2_PACKAGE_XKEYBOARD_CONFIG
	depends on !BR2_PACKAGE_PYTHON3
```

## package/gnome-keyring/Config.in
```kconfig
config BR2_PACKAGE_GNOME_KEYRING
	bool "gnome-keyring"
	depends on BR2_INIT_SYSTEMD
	depends on BR2_PACKAGE_LIBGPG_ERROR_ARCH_SUPPORTS # libgcrypt -> libgpg-error
	depends on BR2_PACKAGE_LINUX_PAM
	depends on BR2_USE_WCHAR # libglib2
	depends on BR2_TOOLCHAIN_HAS_THREADS # libglib2
	depends on BR2_USE_MMU # libglib2
	depends on !BR2_STATIC_LIBS # p11-kit, linux-pam
	select BR2_PACKAGE_DBUS
	select BR2_PACKAGE_GCR3
	select BR2_PACKAGE_LIBCAP_NG
	select BR2_PACKAGE_LIBGCRYPT
	select BR2_PACKAGE_LIBGLIB2
	select BR2_PACKAGE_P11_KIT
	help
	  GNOME Keyring stores passwords and other secrets and
	  implements the freedesktop.org Secret Service D-Bus API
	  (org.freedesktop.secrets), together with a PAM module that
	  unlocks the login keyring at login.

	  https://gitlab.gnome.org/GNOME/gnome-keyring

comment "gnome-keyring needs systemd and a toolchain w/ wchar, threads, dynamic library"
	depends on BR2_PACKAGE_LIBGPG_ERROR_ARCH_SUPPORTS
	depends on BR2_PACKAGE_LINUX_PAM
	depends on BR2_USE_MMU
	depends on !BR2_INIT_SYSTEMD || \
		!BR2_USE_WCHAR || !BR2_TOOLCHAIN_HAS_THREADS || \
		BR2_STATIC_LIBS
```

## package/gnome-online-accounts/Config.in
```kconfig
config BR2_PACKAGE_GNOME_ONLINE_ACCOUNTS
	bool "gnome-online-accounts"
	depends on BR2_PACKAGE_LIBADWAITA
	depends on BR2_PACKAGE_LIBGTK4
	select BR2_PACKAGE_DBUS
	select BR2_PACKAGE_JSON_GLIB
	select BR2_PACKAGE_LIBGLIB2
	select BR2_PACKAGE_LIBREST
	select BR2_PACKAGE_LIBSECRET
	select BR2_PACKAGE_LIBSOUP3
	select BR2_PACKAGE_LIBXML2
	help
	  GNOME Online Accounts (GOA) library, providing the goa-1.0
	  D-Bus interface and helpers consumed by the GNOME Control
	  Center.

	  https://gitlab.gnome.org/GNOME/gnome-online-accounts
```

## package/gnome-session/Config.in
```kconfig
config BR2_PACKAGE_GNOME_SESSION
	bool "gnome-session"
	depends on BR2_INIT_SYSTEMD
	depends on BR2_PACKAGE_LIBGTK3
	depends on BR2_PACKAGE_PYTHON3 # gobject-introspection
	select BR2_PACKAGE_DBUS
	select BR2_PACKAGE_GNOME_DESKTOP
	select BR2_PACKAGE_JSON_GLIB
	select BR2_PACKAGE_LIBGLIB2
	select BR2_PACKAGE_LIBXML2
	select BR2_PACKAGE_XKEYBOARD_CONFIG
	help
	  gnome-session is the GNOME session manager.  It is responsible
	  for orchestrating the user's desktop session: starting
	  gnome-shell, gnome-settings-daemon, the xdg autostart entries,
	  and arbitrating session-end (logout, shutdown, suspend).

	  https://gitlab.gnome.org/GNOME/gnome-session
```

## package/gnome-settings-daemon/Config.in
```kconfig
config BR2_PACKAGE_GNOME_SETTINGS_DAEMON
	bool "gnome-settings-daemon"
	depends on BR2_PACKAGE_NETWORK_MANAGER
	depends on BR2_PACKAGE_PIPEWIRE
	depends on BR2_PACKAGE_UPOWER
	depends on BR2_INIT_SYSTEMD
	depends on BR2_PACKAGE_LIBGTK3
	depends on BR2_PACKAGE_PYTHON3 # gobject-introspection
	select BR2_PACKAGE_ALSA_LIB
	select BR2_PACKAGE_DBUS
	select BR2_PACKAGE_FONTCONFIG
	select BR2_PACKAGE_GEOCLUE
	select BR2_PACKAGE_GEOCODE_GLIB
	select BR2_PACKAGE_GNOME_DESKTOP
	select BR2_PACKAGE_GSETTINGS_DESKTOP_SCHEMAS
	select BR2_PACKAGE_LCMS2
	select BR2_PACKAGE_LIBCANBERRA
	select BR2_PACKAGE_LIBGLIB2
	select BR2_PACKAGE_LIBGUDEV
	select BR2_PACKAGE_LIBGWEATHER
	select BR2_PACKAGE_LIBNOTIFY
	select BR2_PACKAGE_PANGO
	select BR2_PACKAGE_POLKIT
	select BR2_PACKAGE_PULSEAUDIO
	select BR2_PACKAGE_WAYLAND
	select BR2_PACKAGE_XLIB_LIBX11
	select BR2_PACKAGE_XLIB_LIBXEXT
	select BR2_PACKAGE_XLIB_LIBXFIXES
	select BR2_PACKAGE_XLIB_LIBXI
	select BR2_PACKAGE_ADWAITA_FONTS
	select BR2_PACKAGE_SOUND_THEME_FREEDESKTOP
	help
	  GNOME Settings Daemon handles session-wide settings such
	  as keyboard shortcuts, display configuration, power, and
	  media keys.

	  https://gitlab.gnome.org/GNOME/gnome-settings-daemon
```

## package/gnome-shell/Config.in
```kconfig
config BR2_PACKAGE_GNOME_SHELL
	bool "gnome-shell"
	depends on BR2_PACKAGE_GJS
	depends on BR2_PACKAGE_LIBADWAITA
	depends on BR2_PACKAGE_LIBGTK4
	depends on BR2_PACKAGE_NETWORK_MANAGER
	depends on BR2_PACKAGE_GNOME_SETTINGS_DAEMON
	depends on BR2_PACKAGE_MUTTER
	depends on BR2_PACKAGE_PIPEWIRE
	depends on BR2_INIT_SYSTEMD
	depends on BR2_PACKAGE_LLVM_ARCH_SUPPORTS # mozjs140
	depends on BR2_HOST_GCC_AT_LEAST_7 # mozjs140
	depends on BR2_PACKAGE_IBUS
	depends on BR2_PACKAGE_PYTHON3 # gobject-introspection
	select BR2_PACKAGE_GNOME_SESSION
	select BR2_PACKAGE_GNOME_DESKTOP
	select BR2_PACKAGE_EVOLUTION_DATA_SERVER
	select BR2_PACKAGE_GCR
	select BR2_PACKAGE_GDK_PIXBUF
	select BR2_PACKAGE_GSETTINGS_DESKTOP_SCHEMAS
	select BR2_PACKAGE_LIBGLIB2
	select BR2_PACKAGE_LIBXML2
	select BR2_PACKAGE_PANGO
	select BR2_PACKAGE_POLKIT
	select BR2_PACKAGE_RTKIT
	select BR2_PACKAGE_ADWAITA_ICON_THEME
	select BR2_PACKAGE_HICOLOR_ICON_THEME
	select BR2_PACKAGE_ADWAITA_FONTS
	select BR2_PACKAGE_GNOME_BACKGROUNDS
	select BR2_PACKAGE_CANTARELL
	select BR2_PACKAGE_SOUND_THEME_FREEDESKTOP
	select BR2_PACKAGE_SHARED_MIME_INFO
	help
	  GNOME Shell is the user-visible shell of the GNOME 3+
	  desktop environment.  It provides the panel, activities
	  overview, application launcher, and system status menu.
	  Authored in JavaScript on top of mutter and gjs.

	  https://gitlab.gnome.org/GNOME/gnome-shell
```

## package/gnome-software/Config.in
```kconfig
config BR2_PACKAGE_GNOME_SOFTWARE
	bool "gnome-software"
	depends on BR2_PACKAGE_APPSTREAM
	depends on BR2_PACKAGE_FWUPD
	depends on BR2_PACKAGE_FLATPAK
	depends on BR2_PACKAGE_JSON_GLIB
	depends on BR2_PACKAGE_LIBADWAITA
	depends on BR2_PACKAGE_LIBGTK4
	depends on BR2_PACKAGE_LIBSOUP3
	depends on BR2_PACKAGE_LIBXMLB
	select BR2_PACKAGE_GDK_PIXBUF
	select BR2_PACKAGE_GSETTINGS_DESKTOP_SCHEMAS
	select BR2_PACKAGE_LIBGLIB2
	select BR2_PACKAGE_POLKIT
	help
	  GNOME Software is the GNOME application for managing apps,
	  Flatpaks, and device firmware updates through fwupd.

	  https://gitlab.gnome.org/GNOME/gnome-software
```

## package/gweather-locations/Config.in
```kconfig
config BR2_PACKAGE_GWEATHER_LOCATIONS
	bool "gweather-locations"
	help
	  Database of weather-data locations (cities, observation
	  stations) used by libgweather. Split out from libgweather
	  starting with the GNOME 47 release line.

	  https://gitlab.gnome.org/GNOME/gweather-locations
```

## package/ibus/Config.in
```kconfig
config BR2_PACKAGE_IBUS
	bool "ibus"
	depends on BR2_USE_WCHAR # libglib2
	depends on BR2_PACKAGE_GOBJECT_INTROSPECTION_ARCH_SUPPORTS
	depends on BR2_PACKAGE_PYTHON3 # gobject-introspection
	select BR2_PACKAGE_DBUS
	select BR2_PACKAGE_GOBJECT_INTROSPECTION
	select BR2_PACKAGE_LIBGLIB2
	select BR2_PACKAGE_LIBXKBCOMMON
	select BR2_PACKAGE_WAYLAND
	select BR2_PACKAGE_XKEYBOARD_CONFIG
	help
	  Intelligent Input Bus for Linux/Unix.

	  https://github.com/ibus/ibus

comment "ibus needs python3 and a toolchain w/ wchar"
	depends on BR2_PACKAGE_GOBJECT_INTROSPECTION_ARCH_SUPPORTS
	depends on !BR2_USE_WCHAR || !BR2_PACKAGE_PYTHON3
```

## package/iso-codes/Config.in
```kconfig
config BR2_PACKAGE_ISO_CODES
	bool "iso-codes"
	help
	  ISO 639, ISO 3166, ISO 4217, ISO 15924 and ISO 639-3
	  language/country/currency/script lists, with gettext
	  translations.  Required at runtime by gnome-desktop and
	  many GNOME applications.

	  https://salsa.debian.org/iso-codes-team/iso-codes
```

## package/k3s/Config.in
```kconfig
config BR2_PACKAGE_K3S
	bool "k3s"
	depends on BR2_x86_64 || BR2_aarch64
	depends on BR2_INIT_SYSTEMD
	depends on BR2_PACKAGE_HOST_GO_TARGET_ARCH_SUPPORTS
	depends on BR2_PACKAGE_HOST_GO_TARGET_CGO_LINKING_SUPPORTS
	depends on BR2_TOOLCHAIN_HAS_THREADS
	depends on !BR2_TOOLCHAIN_USES_UCLIBC
	depends on BR2_USE_MMU
	select BR2_PACKAGE_HOST_GO
	select BR2_PACKAGE_IPTABLES
	select BR2_PACKAGE_CONTAINERD
	select BR2_PACKAGE_CONTAINERD_CRI
	select BR2_PACKAGE_CONNTRACK_TOOLS
	select BR2_PACKAGE_KMOD
	select BR2_PACKAGE_UTIL_LINUX
	select BR2_PACKAGE_UTIL_LINUX_MOUNT
	select BR2_PACKAGE_UTIL_LINUX_MOUNTPOINT
	select BR2_PACKAGE_LIBSECCOMP
	select BR2_PACKAGE_CNI_PLUGINS
	select BR2_PACKAGE_FLANNEL_CNI_PLUGIN
	help
	  k3s is a lightweight Kubernetes distribution. The k3s
	  multi-call binary bundles Kubernetes control-plane and CLI
	  entry points. This package uses Buildroot's containerd/runc
	  runtime binaries for CRI.

	  https://k3s.io

comment "k3s needs systemd and a glibc/musl toolchain w/ threads"
	depends on BR2_x86_64 || BR2_aarch64
	depends on BR2_PACKAGE_HOST_GO_TARGET_ARCH_SUPPORTS
	depends on BR2_PACKAGE_HOST_GO_TARGET_CGO_LINKING_SUPPORTS
	depends on BR2_USE_MMU
	depends on !BR2_INIT_SYSTEMD || \
		!BR2_TOOLCHAIN_HAS_THREADS || BR2_TOOLCHAIN_USES_UCLIBC
```
