## br2-external/package/puu-gateway-crds/Config.in
```kconfig
config BR2_PACKAGE_PUU_GATEWAY_CRDS
	bool "puu-gateway-crds"
	help
	  Install the pinned Gateway API and Agentgateway CRDs for
	  the Puu K3s add-ons.
```
