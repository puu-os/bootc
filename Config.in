## linux/arm64_efi_defconfig
```kconfig
CONFIG_SYSVIPC=y
CONFIG_POSIX_MQUEUE=y
CONFIG_AUDIT=y
CONFIG_NO_HZ_IDLE=y
CONFIG_BPF_SYSCALL=y
CONFIG_BPF_JIT=y
CONFIG_BPF_JIT_ALWAYS_ON=y
CONFIG_BPF_PRELOAD=y
CONFIG_IKCONFIG=y
CONFIG_IKCONFIG_PROC=y
CONFIG_IKHEADERS=y
CONFIG_NUMA_BALANCING=y
CONFIG_CGROUPS=y
CONFIG_MEMCG=y
CONFIG_BLK_CGROUP=y
CONFIG_CGROUP_SCHED=y
CONFIG_CFS_BANDWIDTH=y
CONFIG_CGROUP_PIDS=y
CONFIG_CGROUP_RDMA=y
CONFIG_CGROUP_FREEZER=y
CONFIG_CPUSETS=y
CONFIG_CGROUP_DEVICE=y
CONFIG_CGROUP_CPUACCT=y
CONFIG_CGROUP_BPF=y
CONFIG_USER_NS=y
CONFIG_PERF_EVENTS=y
CONFIG_ARCH_TEGRA=y
CONFIG_NR_CPUS=256
CONFIG_NUMA=y
CONFIG_RANDOMIZE_BASE=y
CONFIG_CPU_IDLE_GOV_TEO=y
CONFIG_ARM_PSCI_CPUIDLE=y
CONFIG_CPU_FREQ=y
CONFIG_CPU_FREQ_DEFAULT_GOV_PERFORMANCE=y
CONFIG_CPU_FREQ_GOV_SCHEDUTIL=y
CONFIG_ACPI_CPPC_CPUFREQ=y
CONFIG_ACPI=y
CONFIG_ACPI_APEI=y
CONFIG_ACPI_APEI_GHES=y
CONFIG_ACPI_APEI_PCIEAER=y
CONFIG_KPROBES=y
# CONFIG_GCC_PLUGINS is not set
CONFIG_MODULES=y
CONFIG_MODULE_UNLOAD=y
CONFIG_MODULE_FORCE_UNLOAD=y
CONFIG_MEMORY_HOTPLUG=y
CONFIG_MEMORY_HOTREMOVE=y
CONFIG_TRANSPARENT_HUGEPAGE=y
CONFIG_CMA=y
CONFIG_ZONE_DEVICE=y
CONFIG_NET=y
CONFIG_PACKET=y
CONFIG_UNIX=y
CONFIG_INET=y
CONFIG_NETFILTER=y
CONFIG_BRIDGE_NETFILTER=m
CONFIG_NF_CONNTRACK=m
CONFIG_NF_CT_NETLINK=m
CONFIG_NETFILTER_XTABLES_LEGACY=y
CONFIG_NETFILTER_XT_MARK=m
CONFIG_NETFILTER_XT_MATCH_ADDRTYPE=m
CONFIG_NETFILTER_XT_MATCH_COMMENT=m
CONFIG_NETFILTER_XT_MATCH_CONNTRACK=m
CONFIG_NETFILTER_XT_MATCH_IPVS=m
CONFIG_NETFILTER_XT_MATCH_MULTIPORT=m
CONFIG_NETFILTER_XT_MATCH_STATISTIC=m
CONFIG_IP_VS=m
CONFIG_IP_VS_PROTO_TCP=y
CONFIG_IP_VS_PROTO_UDP=y
CONFIG_IP_VS_RR=m
CONFIG_IP_VS_WRR=m
CONFIG_IP_VS_SH=m
CONFIG_IP_VS_NFCT=y
CONFIG_IP_NF_IPTABLES=m
CONFIG_IP_NF_TARGET_REJECT=m
CONFIG_IP_NF_NAT=m
CONFIG_IP_NF_TARGET_MASQUERADE=m
CONFIG_IP_NF_TARGET_REDIRECT=m
CONFIG_IP_NF_RAW=m
CONFIG_IP6_NF_IPTABLES=m
CONFIG_IP6_NF_TARGET_REJECT=m
CONFIG_IP6_NF_RAW=m
CONFIG_IP6_NF_NAT=m
CONFIG_IP6_NF_TARGET_MASQUERADE=m
CONFIG_BRIDGE=y
CONFIG_NET_SCHED=y
CONFIG_NET_SCH_FQ_CODEL=y
CONFIG_NET_CLS_CGROUP=y
CONFIG_NET_CLS_BPF=y
CONFIG_DCB=y
CONFIG_CGROUP_NET_PRIO=y
CONFIG_BT=y
CONFIG_BT_RFCOMM=y
CONFIG_BT_BNEP=y
CONFIG_BT_HIDP=y
CONFIG_BT_HCIBTUSB=y
CONFIG_BT_HCIBTUSB_MTK=y
CONFIG_CFG80211=y
CONFIG_CFG80211_WEXT=y
CONFIG_MAC80211=y
CONFIG_RFKILL=y
CONFIG_PCI=y
CONFIG_PCIEPORTBUS=y
CONFIG_HOTPLUG_PCI_PCIE=y
CONFIG_PCIEAER=y
CONFIG_PCI_IOV=y
CONFIG_PCI_PRI=y
CONFIG_PCI_PASID=y
CONFIG_PCI_P2PDMA=y
CONFIG_HOTPLUG_PCI=y
CONFIG_PCI_HOST_GENERIC=y
CONFIG_PCIE_TEGRA194_HOST=m
CONFIG_DEVTMPFS=y
CONFIG_DEVTMPFS_MOUNT=y
CONFIG_ARM_SCMI_PROTOCOL=y
CONFIG_DMI_SYSFS=y
CONFIG_ARM_FFA_TRANSPORT=y
CONFIG_EFI_CAPSULE_LOADER=y
CONFIG_BLK_DEV_LOOP=y
CONFIG_VIRTIO_BLK=y
CONFIG_BLK_DEV_NVME=y
CONFIG_NTSYNC=m
CONFIG_BLK_DEV_SD=y
CONFIG_BLK_DEV_SR=y
CONFIG_SCSI_VIRTIO=y
CONFIG_ATA=y
CONFIG_SATA_AHCI=y
CONFIG_MD=y
CONFIG_BLK_DEV_DM=y
CONFIG_DM_CRYPT=y
CONFIG_DM_THIN_PROVISIONING=m
CONFIG_NETDEVICES=y
CONFIG_MACVLAN=m
CONFIG_IPVLAN=m
CONFIG_VXLAN=m
CONFIG_TUN=y
CONFIG_VETH=m
CONFIG_VIRTIO_NET=y
CONFIG_AQTION=m
CONFIG_BNX2=m
CONFIG_TIGON3=m
CONFIG_BNX2X=m
CONFIG_E1000E=m
CONFIG_IGC=m
CONFIG_MLX5_CORE=m
CONFIG_MLX5_CORE_EN=y
CONFIG_R8169=m
CONFIG_STMMAC_ETH=m
CONFIG_DWMAC_TEGRA=m
CONFIG_AQUANTIA_PHY=m
CONFIG_MARVELL_PHY=m
CONFIG_USB_RTL8152=m
CONFIG_USB_USBNET=m
CONFIG_ATH9K=m
CONFIG_ATH9K_HTC=m
CONFIG_ATH10K=m
CONFIG_ATH10K_PCI=m
CONFIG_ATH11K=m
CONFIG_ATH11K_PCI=m
CONFIG_ATH12K=m
CONFIG_BRCMFMAC=m
CONFIG_IWLWIFI=m
CONFIG_IWLMVM=m
CONFIG_IWLMLD=m
CONFIG_MT7601U=m
CONFIG_MT76x0E=m
CONFIG_MT76x2E=m
CONFIG_MT7921E=m
CONFIG_MT7921U=m
CONFIG_MT7925E=m
CONFIG_MT7925U=m
CONFIG_RTW88=m
CONFIG_RTW88_8822BE=m
CONFIG_RTW88_8822CE=m
CONFIG_RTW88_8723DE=m
CONFIG_RTW88_8821CE=m
CONFIG_RTW89=m
CONFIG_RTW89_8922AE=m
CONFIG_INPUT_EVDEV=y
CONFIG_SERIAL_8250=y
CONFIG_SERIAL_8250_CONSOLE=y
CONFIG_SERIAL_OF_PLATFORM=y
CONFIG_SERIAL_AMBA_PL011=y
CONFIG_SERIAL_AMBA_PL011_CONSOLE=y
CONFIG_VIRTIO_CONSOLE=y
CONFIG_HW_RANDOM_VIRTIO=m
CONFIG_TCG_TPM=y
CONFIG_TCG_TPM2_HMAC=y
CONFIG_TCG_CRB=y
CONFIG_MEDIA_SUPPORT=y
CONFIG_DRM=y
CONFIG_DRM_AMDGPU=m
CONFIG_DRM_NOUVEAU=m
CONFIG_DRM_PANTHOR=m
CONFIG_DRM_RADEON=m
CONFIG_DRM_SIMPLEDRM=y
CONFIG_DRM_VIRTIO_GPU=y
CONFIG_DRM_XE=m
CONFIG_FB=y
CONFIG_FB_EFI=y
CONFIG_FIRMWARE_EDID=y
CONFIG_SOUND=y
CONFIG_SND=y
CONFIG_SND_HDA_TEGRA=y
CONFIG_SND_HDA_GENERIC=y
CONFIG_SND_HDA_CODEC_HDMI=y
CONFIG_HIDRAW=y
CONFIG_USB=y
CONFIG_USB_XHCI_HCD=y
CONFIG_USB_XHCI_PLATFORM=y
CONFIG_USB_XHCI_TEGRA=m
CONFIG_USB_EHCI_HCD=y
CONFIG_USB_STORAGE=y
CONFIG_INFINIBAND=m
CONFIG_INFINIBAND_USER_MAD=m
CONFIG_INFINIBAND_USER_ACCESS=m
CONFIG_MLX5_INFINIBAND=m
CONFIG_RDMA_RXE=m
CONFIG_RTC_CLASS=y
CONFIG_RTC_DRV_EFI=y
CONFIG_DMABUF_HEAPS=y
CONFIG_VIRTIO_PCI=y
CONFIG_VIRTIO_BALLOON=y
CONFIG_VIRTIO_INPUT=y
CONFIG_VIRTIO_MMIO=y
CONFIG_VIRTIO_MMIO_CMDLINE_DEVICES=y
CONFIG_ARM_SMMU=y
CONFIG_ARM_SMMU_V3=y
CONFIG_ARM_SMMU_V3_SVA=y
CONFIG_PHY_TEGRA_XUSB=m
CONFIG_EXT4_FS=y
CONFIG_EXT4_FS_POSIX_ACL=y
CONFIG_XFS_FS=y
CONFIG_XFS_POSIX_ACL=y
CONFIG_BTRFS_FS=y
CONFIG_BTRFS_FS_POSIX_ACL=y
CONFIG_FS_ENCRYPTION=y
CONFIG_FS_VERITY=y
CONFIG_FS_VERITY_BUILTIN_SIGNATURES=y
CONFIG_QFMT_V2=y
CONFIG_AUTOFS_FS=y
CONFIG_FUSE_FS=y
CONFIG_OVERLAY_FS=y
CONFIG_OVERLAY_FS_INDEX=y
CONFIG_OVERLAY_FS_METACOPY=y
CONFIG_MSDOS_FS=y
CONFIG_VFAT_FS=y
CONFIG_ISO9660_FS=y
CONFIG_FAT_DEFAULT_UTF8=y
CONFIG_EXFAT_FS=y
CONFIG_TMPFS_POSIX_ACL=y
CONFIG_TMPFS_QUOTA=y
CONFIG_HUGETLBFS=y
CONFIG_EFIVAR_FS=y
CONFIG_SQUASHFS=y
CONFIG_SQUASHFS_XATTR=y
CONFIG_SQUASHFS_ZSTD=y
CONFIG_EROFS_FS=y
CONFIG_NLS_CODEPAGE_437=y
CONFIG_NLS_CODEPAGE_850=y
CONFIG_NLS_ISO8859_1=y
CONFIG_NLS_UTF8=y
CONFIG_TRUSTED_KEYS=y
CONFIG_ENCRYPTED_KEYS=y
CONFIG_USER_DECRYPTED_DATA=y
CONFIG_KEY_DH_OPERATIONS=y
CONFIG_SECURITY=y
CONFIG_SECURITY_LOCKDOWN_LSM=y
CONFIG_LOCK_DOWN_KERNEL_FORCE_INTEGRITY=y
CONFIG_CRYPTO_DES=y
CONFIG_CRYPTO_CMAC=y
CONFIG_CRYPTO_MD4=y
CONFIG_CRYPTO_MD5=y
CONFIG_CRYPTO_SHA1=y
CONFIG_CRYPTO_USER_API_HASH=y
CONFIG_CRYPTO_USER_API_SKCIPHER=y
CONFIG_CRYPTO_GHASH_ARM64_CE=y
CONFIG_PKCS8_PRIVATE_KEY_PARSER=y
CONFIG_DMA_CMA=y
CONFIG_CMA_SIZE_MBYTES=256
CONFIG_DEBUG_KERNEL=y
CONFIG_DEBUG_INFO_DWARF5=y
CONFIG_DEBUG_INFO_BTF=y
CONFIG_READABLE_ASM=y
CONFIG_MAGIC_SYSRQ=y
CONFIG_DEBUG_FS=y
CONFIG_BOOTTIME_TRACING=y
CONFIG_FUNCTION_TRACER=y
CONFIG_FUNCTION_GRAPH_RETVAL=y
CONFIG_FPROBE=y
CONFIG_FTRACE_SYSCALLS=y
CONFIG_HIST_TRIGGERS=y
```

## package/accountsservice/Config.in
```kconfig
config BR2_PACKAGE_ACCOUNTSSERVICE
	bool "accountsservice"
	depends on BR2_USE_WCHAR # glib2
	depends on BR2_PACKAGE_GOBJECT_INTROSPECTION_ARCH_SUPPORTS
	depends on BR2_PACKAGE_PYTHON3 # gobject-introspection
	select BR2_PACKAGE_DBUS
	select BR2_PACKAGE_JSON_C
	select BR2_PACKAGE_LIBGLIB2
	select BR2_PACKAGE_POLKIT
	select BR2_PACKAGE_GOBJECT_INTROSPECTION
	help
	  D-Bus service for querying and manipulating user account
	  information via the org.freedesktop.Accounts API.

	  https://www.freedesktop.org/software/accountsservice/

comment "accountsservice needs a toolchain w/ wchar"
	depends on BR2_PACKAGE_GOBJECT_INTROSPECTION_ARCH_SUPPORTS
	depends on !BR2_USE_WCHAR
```

## package/adwaita-fonts/Config.in
```kconfig
config BR2_PACKAGE_ADWAITA_FONTS
	bool "adwaita-fonts"
	help
	  Adwaita Sans and Adwaita Mono are GNOME's interface and
	  monospace fonts starting with GNOME 48.

	  https://gitlab.gnome.org/GNOME/adwaita-fonts
```

## package/bolt/Config.in
```kconfig
config BR2_PACKAGE_BOLT
	bool "bolt"
	depends on BR2_PACKAGE_SYSTEMD
	depends on BR2_USE_MMU # libglib2, polkit
	depends on BR2_USE_WCHAR # libglib2, libgudev
	depends on BR2_TOOLCHAIN_HAS_THREADS # libglib2, libgudev
	select BR2_PACKAGE_LIBGLIB2
	select BR2_PACKAGE_LIBGUDEV
	select BR2_PACKAGE_POLKIT
	help
	  Thunderbolt 3 and USB4 device manager daemon used by GNOME
	  Shell for device enrollment and authorization.

	  https://gitlab.freedesktop.org/bolt/bolt

comment "bolt needs systemd and a toolchain w/ wchar, threads"
	depends on BR2_USE_MMU
	depends on !BR2_PACKAGE_SYSTEMD || !BR2_USE_WCHAR || \
		!BR2_TOOLCHAIN_HAS_THREADS
```

## package/bootc/Config.in
```kconfig
config BR2_PACKAGE_BOOTC
	bool "bootc"
	depends on BR2_PACKAGE_HOST_RUSTC_TARGET_ARCH_SUPPORTS
	depends on BR2_PACKAGE_LIBOSTREE
	depends on BR2_PACKAGE_COMPOSEFS
	depends on BR2_INIT_SYSTEMD
	select BR2_PACKAGE_HOST_RUSTC
	select BR2_PACKAGE_OPENSSL
	select BR2_PACKAGE_ZSTD
	help
	  bootc transactionally fetches OCI containers as a bootable
	  host system. This package provides the bootc binary, its
	  systemd units and dracut module.

	  https://github.com/bootc-dev/bootc

comment "bootc needs a systemd init"
	depends on BR2_PACKAGE_HOST_RUSTC_TARGET_ARCH_SUPPORTS
	depends on BR2_PACKAGE_LIBOSTREE
	depends on BR2_PACKAGE_COMPOSEFS
	depends on !BR2_INIT_SYSTEMD
```

## package/colord-gtk/Config.in
```kconfig
config BR2_PACKAGE_COLORD_GTK
	bool "colord-gtk"
	depends on BR2_PACKAGE_LIBGTK4
	select BR2_PACKAGE_COLORD
	select BR2_PACKAGE_LIBGLIB2
	help
	  Gtk4 widgets for colord, providing the colord-gtk4 library
	  used by the GNOME Settings color panel.

	  https://www.freedesktop.org/software/colord/releases/
```

## package/colord/Config.in
```kconfig
config BR2_PACKAGE_COLORD
	bool "colord"
	depends on BR2_PACKAGE_HAS_UDEV
	depends on BR2_INIT_SYSTEMD
	select BR2_PACKAGE_DBUS
	select BR2_PACKAGE_HWDATA
	select BR2_PACKAGE_LCMS2
	select BR2_PACKAGE_LIBGLIB2
	select BR2_PACKAGE_LIBGUDEV
	select BR2_PACKAGE_LIBGUSB
	select BR2_PACKAGE_POLKIT
	select BR2_PACKAGE_SQLITE
	help
	  System service for color management. Provides device color
	  profiles to GNOME (mutter, gnome-settings-daemon) and other
	  display stacks.

	  https://www.freedesktop.org/software/colord/
```

## package/composefs/Config.in
```kconfig
config BR2_PACKAGE_COMPOSEFS
	bool "composefs"
	select BR2_PACKAGE_LIBFUSE3
	select BR2_PACKAGE_OPENSSL
	help
	  composefs creates and mounts read-only filesystem images using
	  a content-addressed backing store.

	  https://github.com/containers/composefs
```

## package/dconf/Config.in
```kconfig
config BR2_PACKAGE_DCONF
	bool "dconf"
	select BR2_PACKAGE_LIBGLIB2
	help
	  Low-level configuration system used by GNOME for application
	  preferences. Provides the dconf D-Bus service plus a `dconf`
	  CLI for compiling/reading the binary settings database.

	  https://gitlab.gnome.org/GNOME/dconf
```

## package/evolution-data-server/Config.in
```kconfig
config BR2_PACKAGE_EVOLUTION_DATA_SERVER
	bool "evolution-data-server"
	depends on BR2_PACKAGE_LIBSOUP3
	depends on BR2_PACKAGE_LIBNSS
	depends on BR2_PACKAGE_LIBSECRET
	select BR2_PACKAGE_ICU
	select BR2_PACKAGE_JSON_GLIB
	select BR2_PACKAGE_LIBGLIB2
	select BR2_PACKAGE_LIBICAL
	select BR2_PACKAGE_LIBNSPR
	select BR2_PACKAGE_LIBXML2
	select BR2_PACKAGE_LIBXSLT
	select BR2_PACKAGE_SQLITE
	help
	  Address book and calendar back-ends used by GNOME (gnome-shell
	  consumes libecal-2.0 / libedataserver-1.2 for the calendar
	  widget).

	  https://gitlab.gnome.org/GNOME/evolution-data-server
```

## package/flannel-cni-plugin/Config.in
```kconfig
config BR2_PACKAGE_FLANNEL_CNI_PLUGIN
	bool "flannel-cni-plugin"
	depends on BR2_x86_64 || BR2_aarch64
	depends on BR2_PACKAGE_HOST_GO_TARGET_ARCH_SUPPORTS
	depends on BR2_PACKAGE_HOST_GO_TARGET_CGO_LINKING_SUPPORTS
	depends on BR2_TOOLCHAIN_HAS_THREADS
	depends on !BR2_TOOLCHAIN_USES_UCLIBC
	depends on BR2_USE_MMU
	select BR2_PACKAGE_HOST_GO
	help
	  Flannel CNI plugin wrapper used by k3s CNI configuration.

	  https://github.com/flannel-io/cni-plugin

comment "flannel-cni-plugin needs a glibc/musl toolchain w/ threads, and x86_64/aarch64"
	depends on !(BR2_x86_64 || BR2_aarch64) || \
		!BR2_TOOLCHAIN_HAS_THREADS || BR2_TOOLCHAIN_USES_UCLIBC
```
