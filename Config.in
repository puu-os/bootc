## Config.in
```kconfig
# SPDX-License-Identifier: GPL-2.0-or-later
# Copyright (C) Opinsys Oy 2026

source "$BR2_EXTERNAL_PUU_PATH/package/composefs/Config.in"
source "$BR2_EXTERNAL_PUU_PATH/package/bootc/Config.in"
source "$BR2_EXTERNAL_PUU_PATH/package/flannel-cni-plugin/Config.in"
source "$BR2_EXTERNAL_PUU_PATH/package/k3s/Config.in"
source "$BR2_EXTERNAL_PUU_PATH/package/oksa-crds/Config.in"
source "$BR2_EXTERNAL_PUU_PATH/package/oksa-services/Config.in"
source "$BR2_EXTERNAL_PUU_PATH/package/puu-installer/Config.in"

source "$BR2_EXTERNAL_PUU_PATH/package/libfyaml/Config.in"
source "$BR2_EXTERNAL_PUU_PATH/package/appstream/Config.in"
source "$BR2_EXTERNAL_PUU_PATH/package/flatpak/Config.in"
source "$BR2_EXTERNAL_PUU_PATH/package/adwaita-fonts/Config.in"
source "$BR2_EXTERNAL_PUU_PATH/package/accountsservice/Config.in"
source "$BR2_EXTERNAL_PUU_PATH/package/iso-codes/Config.in"
source "$BR2_EXTERNAL_PUU_PATH/package/geoclue/Config.in"
source "$BR2_EXTERNAL_PUU_PATH/package/bolt/Config.in"
source "$BR2_EXTERNAL_PUU_PATH/package/rtkit/Config.in"
source "$BR2_EXTERNAL_PUU_PATH/package/colord/Config.in"
source "$BR2_EXTERNAL_PUU_PATH/package/colord-gtk/Config.in"
source "$BR2_EXTERNAL_PUU_PATH/package/dconf/Config.in"
source "$BR2_EXTERNAL_PUU_PATH/package/evolution-data-server/Config.in"
source "$BR2_EXTERNAL_PUU_PATH/package/geocode-glib/Config.in"
source "$BR2_EXTERNAL_PUU_PATH/package/gweather-locations/Config.in"
source "$BR2_EXTERNAL_PUU_PATH/package/libei/Config.in"
source "$BR2_EXTERNAL_PUU_PATH/package/libgrapheme/Config.in"
source "$BR2_EXTERNAL_PUU_PATH/package/libgusb/Config.in"
source "$BR2_EXTERNAL_PUU_PATH/package/libgtop/Config.in"
source "$BR2_EXTERNAL_PUU_PATH/package/libgweather/Config.in"
source "$BR2_EXTERNAL_PUU_PATH/package/libnotify/Config.in"
source "$BR2_EXTERNAL_PUU_PATH/package/librest/Config.in"
source "$BR2_EXTERNAL_PUU_PATH/package/libwacom/Config.in"
source "$BR2_EXTERNAL_PUU_PATH/package/gsound/Config.in"
source "$BR2_EXTERNAL_PUU_PATH/package/gnome-backgrounds/Config.in"
source "$BR2_EXTERNAL_PUU_PATH/package/gnome-bluetooth/Config.in"
source "$BR2_EXTERNAL_PUU_PATH/package/gnome-desktop/Config.in"
source "$BR2_EXTERNAL_PUU_PATH/package/gnome-online-accounts/Config.in"
source "$BR2_EXTERNAL_PUU_PATH/package/xdg-desktop-portal/Config.in"
source "$BR2_EXTERNAL_PUU_PATH/package/xdg-desktop-portal-gnome/Config.in"
source "$BR2_EXTERNAL_PUU_PATH/package/xdg-desktop-portal-gtk/Config.in"
source "$BR2_EXTERNAL_PUU_PATH/package/libnma/Config.in"
source "$BR2_EXTERNAL_PUU_PATH/package/ibus/Config.in"
source "$BR2_EXTERNAL_PUU_PATH/package/libadwaita/Config.in"
source "$BR2_EXTERNAL_PUU_PATH/package/mozjs140/Config.in"
source "$BR2_EXTERNAL_PUU_PATH/package/gjs/Config.in"
source "$BR2_EXTERNAL_PUU_PATH/package/glycin/Config.in"
source "$BR2_EXTERNAL_PUU_PATH/package/mutter/Config.in"
source "$BR2_EXTERNAL_PUU_PATH/package/gnome-settings-daemon/Config.in"
source "$BR2_EXTERNAL_PUU_PATH/package/gnome-session/Config.in"
source "$BR2_EXTERNAL_PUU_PATH/package/gnome-shell/Config.in"
source "$BR2_EXTERNAL_PUU_PATH/package/gnome-control-center/Config.in"
source "$BR2_EXTERNAL_PUU_PATH/package/gnome-software/Config.in"
source "$BR2_EXTERNAL_PUU_PATH/package/gdm/Config.in"
source "$BR2_EXTERNAL_PUU_PATH/package/gcr3/Config.in"
source "$BR2_EXTERNAL_PUU_PATH/package/gnome-keyring/Config.in"
source "$BR2_EXTERNAL_PUU_PATH/package/plymouth/Config.in"

source "$BR2_EXTERNAL_PUU_PATH/package/nvidia-container-toolkit/Config.in"
source "$BR2_EXTERNAL_PUU_PATH/package/toolbx/Config.in"
```

## br2-external/package/appstream/Config.in
```kconfig
config BR2_PACKAGE_APPSTREAM
	bool "appstream"
	depends on !BR2_STATIC_LIBS # glib2
	depends on BR2_TOOLCHAIN_HAS_THREADS # glib2
	depends on BR2_USE_MMU # glib2
	depends on BR2_USE_WCHAR # glib2
	select BR2_PACKAGE_LIBGLIB2
	select BR2_PACKAGE_LIBXML2
	select BR2_PACKAGE_LIBCURL
	select BR2_PACKAGE_LIBFYAML
	select BR2_PACKAGE_LIBXMLB
	select BR2_PACKAGE_BASH_COMPLETION
	select BR2_PACKAGE_ZSTD
	help
	  AppStream is a cross-distro XML format for providing metadata
	  about software components, and a library providing functions
	  to access and manipulate that data.

	  https://www.freedesktop.org/software/appstream/

comment "appstream needs a toolchain w/ wchar, threads, dynamic library"
	depends on BR2_USE_MMU
	depends on !BR2_USE_WCHAR || !BR2_TOOLCHAIN_HAS_THREADS || BR2_STATIC_LIBS
```

## br2-external/package/geocode-glib/Config.in
```kconfig
config BR2_PACKAGE_GEOCODE_GLIB
	bool "geocode-glib"
	depends on BR2_PACKAGE_LIBSOUP3
	select BR2_PACKAGE_JSON_GLIB
	select BR2_PACKAGE_LIBGLIB2
	help
	  Convenience library for the geocoding (finding longitude
	  and latitude from an address) and reverse geocoding
	  (finding an address from coordinates) using the Nominatim
	  service. Used by GNOME for the Map application and by
	  components such as gnome-settings-daemon for night-light
	  scheduling.

	  https://gitlab.gnome.org/GNOME/geocode-glib
```

## br2-external/package/gjs/Config.in
```kconfig
config BR2_PACKAGE_GJS
	bool "gjs"
	depends on BR2_INSTALL_LIBSTDCPP # mozjs140
	depends on BR2_PACKAGE_HOST_RUSTC_TARGET_ARCH_SUPPORTS # mozjs140
	depends on BR2_PACKAGE_PYTHON3 # mozjs140
	depends on BR2_PACKAGE_LLVM_ARCH_SUPPORTS # mozjs140
	depends on BR2_PACKAGE_GOBJECT_INTROSPECTION_ARCH_SUPPORTS
	depends on BR2_PACKAGE_MOZJS140
	depends on BR2_HOST_GCC_AT_LEAST_7 # mozjs140
	select BR2_PACKAGE_GOBJECT_INTROSPECTION
	select BR2_PACKAGE_LIBGLIB2
	select BR2_PACKAGE_CAIRO
	help
	  GJS is JavaScript bindings for the GNOME platform APIs
	  (GObject introspection).  GNOME Shell's UI is written in
	  GJS.

	  https://gitlab.gnome.org/GNOME/gjs

comment "gjs needs a toolchain w/ C++, python3, host gcc >= 7"
	depends on BR2_PACKAGE_GOBJECT_INTROSPECTION_ARCH_SUPPORTS
	depends on BR2_PACKAGE_MOZJS140
	depends on BR2_PACKAGE_HOST_RUSTC_TARGET_ARCH_SUPPORTS
	depends on BR2_PACKAGE_LLVM_ARCH_SUPPORTS
	depends on !BR2_INSTALL_LIBSTDCPP || \
		!BR2_PACKAGE_PYTHON3 || \
		!BR2_HOST_GCC_AT_LEAST_7
```

## br2-external/package/gnome-backgrounds/Config.in
```kconfig
config BR2_PACKAGE_GNOME_BACKGROUNDS
	bool "gnome-backgrounds"
	select BR2_PACKAGE_GSETTINGS_DESKTOP_SCHEMAS
	help
	  Default GNOME wallpapers and background-chooser
	  metadata used by gnome-shell and Settings.

	  https://gitlab.gnome.org/GNOME/gnome-backgrounds
```

## br2-external/package/gnome-bluetooth/Config.in
```kconfig
config BR2_PACKAGE_GNOME_BLUETOOTH
	bool "gnome-bluetooth"
	depends on BR2_PACKAGE_LIBADWAITA
	depends on BR2_PACKAGE_LIBGTK4
	select BR2_PACKAGE_GSOUND
	select BR2_PACKAGE_LIBGLIB2
	select BR2_PACKAGE_LIBNOTIFY
	select BR2_PACKAGE_UPOWER
	help
	  GNOME Bluetooth pairing/management library and panel widgets
	  (gnome-bluetooth-3.0 / gnome-bluetooth-ui-3.0) used by
	  gnome-control-center.

	  https://gitlab.gnome.org/GNOME/gnome-bluetooth
```

## br2-external/package/gsound/Config.in
```kconfig
config BR2_PACKAGE_GSOUND
	bool "gsound"
	select BR2_PACKAGE_LIBCANBERRA
	select BR2_PACKAGE_LIBGLIB2
	help
	  Small GObject wrapper around libcanberra exposing the
	  gsound-1.0 D-Bus / GIO API consumed by gnome-bluetooth and
	  other GNOME components.

	  https://gitlab.gnome.org/GNOME/gsound
```

## br2-external/package/libgtop/Config.in
```kconfig
config BR2_PACKAGE_LIBGTOP
	bool "libgtop"
	select BR2_PACKAGE_LIBGLIB2
	help
	  Library for getting system information (CPU, memory,
	  processes, etc.). Used by gnome-control-center and other
	  GNOME utilities.

	  https://gitlab.gnome.org/GNOME/libgtop
```

## br2-external/package/libwacom/Config.in
```kconfig
config BR2_PACKAGE_LIBWACOM
	bool "libwacom"
	select BR2_PACKAGE_LIBEVDEV
	select BR2_PACKAGE_LIBGLIB2
	select BR2_PACKAGE_LIBGUDEV
	help
	  Library identifying Wacom (and Wacom-like) tablets, used by
	  the GNOME Settings Wacom panel and libinput to map device
	  capabilities and per-button quirks.

	  https://github.com/linuxwacom/libwacom
```

## br2-external/package/rtkit/Config.in
```kconfig
config BR2_PACKAGE_RTKIT
	bool "rtkit"
	depends on BR2_INIT_SYSTEMD
	select BR2_PACKAGE_DBUS
	select BR2_PACKAGE_LIBCAP
	select BR2_PACKAGE_POLKIT
	help
	  RealtimeKit is a D-Bus system service that safely grants
	  realtime scheduling and high-priority requests to desktop
	  clients such as GNOME Shell and PulseAudio.

	  https://github.com/heftig/rtkit
```

## br2-external/package/xdg-desktop-portal-gnome/Config.in
```kconfig
config BR2_PACKAGE_XDG_DESKTOP_PORTAL_GNOME
	bool "xdg-desktop-portal-gnome"
	depends on BR2_PACKAGE_XDG_DESKTOP_PORTAL
	depends on BR2_PACKAGE_GNOME_DESKTOP
	depends on BR2_PACKAGE_LIBADWAITA
	depends on BR2_PACKAGE_LIBGTK4
	depends on BR2_PACKAGE_MUTTER
	select BR2_PACKAGE_FONTCONFIG
	select BR2_PACKAGE_GSETTINGS_DESKTOP_SCHEMAS
	help
	  GNOME back-end implementation for xdg-desktop-portal
	  providing screen cast, remote desktop, background apps,
	  and screenshot portals.

	  https://gitlab.gnome.org/GNOME/xdg-desktop-portal-gnome
```

## br2-external/package/zram-generator/Config.in
```kconfig
config BR2_PACKAGE_ZRAM_GENERATOR
	bool "zram-generator"
	depends on BR2_PACKAGE_HOST_RUSTC_TARGET_ARCH_SUPPORTS
	depends on BR2_INIT_SYSTEMD
	select BR2_PACKAGE_HOST_RUSTC
	select BR2_PACKAGE_UTIL_LINUX_BINARIES
	help
	  A systemd generator that configures compressed RAM block
	  devices as swap devices or file systems.

	  https://github.com/systemd/zram-generator

comment "zram-generator needs a systemd init"
	depends on BR2_PACKAGE_HOST_RUSTC_TARGET_ARCH_SUPPORTS
	depends on !BR2_INIT_SYSTEMD
```
